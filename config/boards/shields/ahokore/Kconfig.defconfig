## config/boards/shields/ahokore/Kconfig.defconfig
```kconfig
# Copyright (c) 2020 The ZMK Contributors
# SPDX-License-Identifier: MIT

if SHIELD_AHOKORE

config ZMK_KEYBOARD_NAME
    default "Ahokore"

endif
```
